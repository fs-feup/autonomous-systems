VERSION "HIPBNYYYYYYYYYYYYYYYYYYYYYYYYYYYYYYYYYYYYY/4/%%%/4/'%**4YYY///"

NS_ :

BS_:

BU_: NodeOne NodeTwo

BO_ 111 Measurement: 8 NodeOne
 SG_ Position : 0|8@1+ (0.1,-10) [-10|10] "m"  NodeTwo
 SG_ Temperature : 8|32@0- (0.55,-32) [0|0] "C" Vector__XXX

CM_ BU_ NodeOne "Sending node";
CM_ BU_ NodeTwo "Receiving Node";
CM_ BO_ 111 "Temperature and proximity";
CM_ SG_ 111 Position "Proximity sensor";
CM_ SG_ 111 Temperature "Voltage Temperature Sensor";
BA_DEF_  "BusType" STRING ;
BA_DEF_DEF_  "BusType" "";
BA_ "BusType" "CAN";
